## sdkconfig.defaults
```kconfig
#
# Modbus Example Configuration
#
CONFIG_ENV_GPIO_RANGE_MIN=0
CONFIG_ENV_GPIO_RANGE_MAX=39
CONFIG_ENV_GPIO_IN_RANGE_MAX=39
CONFIG_ENV_GPIO_OUT_RANGE_MAX=33
CONFIG_MB_UART_PORT_NUM=2
CONFIG_MB_UART_BAUD_RATE=9600
CONFIG_MB_UART_RXD=5
CONFIG_MB_UART_TXD=17
CONFIG_MB_UART_RTS=16
CONFIG_MB_COMM_MODE_RTU=y
# CONFIG_MB_COMM_MODE_ASCII is not set
# end of Modbus Example Configuration

#
# Example Ethernet Configuration
#
CONFIG_EXAMPLE_USE_INTERNAL_ETHERNET=y
# CONFIG_EXAMPLE_ETH_PHY_IP101 is not set
# CONFIG_EXAMPLE_ETH_PHY_RTL8201 is not set
CONFIG_EXAMPLE_ETH_PHY_LAN87XX=y
# CONFIG_EXAMPLE_ETH_PHY_DP83848 is not set
# CONFIG_EXAMPLE_ETH_PHY_KSZ80XX is not set
CONFIG_EXAMPLE_ETH_MDC_GPIO=23
CONFIG_EXAMPLE_ETH_MDIO_GPIO=18
CONFIG_EXAMPLE_ETH_PHY_RST_GPIO=16
CONFIG_EXAMPLE_ETH_PHY_ADDR=1
# CONFIG_EXAMPLE_USE_SPI_ETHERNET is not set
# end of Example Ethernet Configuration
```
